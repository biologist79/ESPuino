## Kconfig
```kconfig
menu "Hidden Helpers"
	visible if n

config CONVERT_TO_IDENTIFIER
	bool
	default y

config EXPORT_TO_PIO
	bool
	default y

endmenu

menu "ESPuino General Settings"

config ESPUINO_DEBUG
	bool "Enables debugging features"
	default n
	depends on EXPERT

config FTP
	bool "Enables support for FTP Server"
	default y
	help
	  To activate use CMD_ENABLE_FTP_SERVER which is assigned to pressing
	  the play/pause and next buttons at the same time.

choice
	bool "Set the language used in logs and web config"
	default LANGUAGE_DE

config LANGUAGE_DE
	bool "German"

config LANGUAGE_EN
	bool "English"

endchoice

config FILENAME_BACKUP
	string "Name of the backup file on the SD card"
	default "/backup.txt"
	help
	   The backup file is used to store NVS records on SD card. The file is
	   updated each time a (new) RFID assignment via GUI is done.

config FILENAME_PLAYLIST_CACHE_V1
	string "Name of the playlist cache file on the SD card (Arduino v1)"
	default "playlistcache.csv"

config FILENAME_PLAYLIST_CACHE
	string "Name of the playlist cache file on the SD card (Arduino >= v2)"
	default "playlistcache2.csv"

config MDNS
	bool "Enables support for MDNS"
	default y
	help
	  When enabled, you don't have to handle with ESPuino's IP address.
	  If hostname is set to "ESPuino", you can reach it via
	  http://ESPuino.local.

menuconfig MQTT
	bool "Enable support for MQTT"
	default n
	help
	  Make sure to configure mqtt-server and (optionally) username+pwd.

if MQTT

config MQTT_RETRY_INTERVAL
	int "Interval in seconds to retry after MQTT connection is down"
	default 60

config MQTT_RETRY_COUNT
	int "Number of retries per interval"
	default 1

config MQTT_HOSTNAME
	string "Hostname used for MQTT"
	default "ESP32-ESPuino"

config MQTT_TOPIC_SLEEP_CMND
	string "MQTT topic for sleep command"
	default "Cmnd/ESPuino/Sleep"

config MQTT_TOPIC_SLEEP_STATE
	string "MQTT topic for sleep state"
	default "State/ESPuino/Sleep"

config MQTT_TOPIC_RFID_CMND
	string "MQTT topic for RFID command"
	default "Cmnd/ESPuino/Rfid"

config MQTT_TOPIC_RFID_STATE
	string "MQTT topic for RFID state"
	default "State/ESPuino/Rfid"

config MQTT_TOPIC_TRACK_STATE
	string "MQTT topic for track state"
	default "State/ESPuino/Track"

config MQTT_TOPIC_TRACK_CTRL_CMND
	string "MQTT topic for track control command"
	default "Cmnd/ESPuino/TrackControl"

config MQTT_TOPIC_COVER_CHANGED_STATE
	string "MQTT topic for cover changed state"
	default "State/ESPuino/CoverChanged"

config MQTT_TOPIC_VOLUME_CMND
	string "MQTT topic for volume command"
	default "Cmnd/ESPuino/Loudness"

config MQTT_TOPIC_VOLUME_STATE
	string "MQTT topic for volume state"
	default "State/ESPuino/Loudness"

config MQTT_TOPIC_SLEEP_TIMER_CMND
	string "MQTT topic for sleep timer command"
	default "Cmnd/ESPuino/SleepTimer"

config MQTT_TOPIC_SLEEP_TIMER_STATE
	string "MQTT topic for sleep timer state"
	default "State/ESPuino/SleepTimer"

config MQTT_TOPIC_STATE
	string "MQTT topic for generic state"
	default "State/ESPuino/State"

config MQTT_TOPIC_IPV4_STATE
	string "MQTT topic for current IPv4 address state"
	default "State/ESPuino/IPv4"

config MQTT_TOPIC_LOCK_CONTROLS_CMND
	string "MQTT topic for controls lock command"
	default "Cmnd/ESPuino/LockControls"

config MQTT_TOPIC_LOCK_CONTROLS_STATE
	string "MQTT topic for controls lock state"
	default "State/ESPuino/LockControls"

config MQTT_TOPIC_PLAYMODE_STATE
	string "MQTT topic for playmode state"
	default "State/ESPuino/Playmode"

config MQTT_TOPIC_REPEAT_MODE_CMND
	string "MQTT topic for repeat mode command"
	default "Cmnd/ESPuino/RepeatMode"

config MQTT_TOPIC_REPEAT_MODE_STATE
	string "MQTT topic for repeat mode state"
	default "State/ESPuino/RepeatMode"

config MQTT_TOPIC_LED_BRIGHTNESS_CMND
	string "MQTT topic for LED brightness command"
	default "Cmnd/ESPuino/LedBrightness"

config MQTT_TOPIC_LED_BRIGHTNESS_STATE
	string "MQTT topic for LED brightness state"
	default "State/ESPuino/LedBrightness"

config MQTT_TOPIC_WIFI_RSSI_STATE
	string "MQTT topic for WiFi RSSI state"
	default "State/ESPuino/WifiRssi"

config MQTT_TOPIC_SW_REVISION_STATE
	string "MQTT topic for software revision state"
	default "State/ESPuino/SoftwareRevision"

config MQTT_TOPIC_SW_REVISION_STATE
	string "MQTT topic for battery voltage state"
	default "State/ESPuino/Voltage"
	depends on MEASURE_BATTERY

config MQTT_TOPIC_BATTERY_CHARGE_STATE
	string "MQTT topic for battery charge state"
	default "State/ESPuino/Battery"
	depends on MEASURE_BATTERY

endif # MQTT

config PAUSE_ON_MIN_VOLUME
	bool "Playback is paused as long as volume is zero"
	default n
	help
	  When playback is active and volume is changed to zero, playback is
	  paused automatically. Playback is continued if unmuted. See
	  https://forum.espuino.de/t/neues-feature-pausieren-wenn-rfid-karte-entfernt-wurde/541
	  for more information.

config PAUSE_WHEN_RFID_REMOVED
	bool "Playback is only enabled as long as RFID tag is in range"
	default n
	help
	  See https://forum.espuino.de/t/neues-feature-pausieren-wenn-rfid-karte-entfernt-wurde/541
	  for more information.

config ACCEPT_SAME_RFID_AFTER_TRACK_END
	bool "Allow same RFID tag to be played after playback has finished"
	default y
	depends on PAUSE_WHEN_RFID_REMOVED
	help
	  IF enabled the same tag can be applied after playback has finished in
	  case PAUSE_WHEN_RFID_REMOVED is enabled.

config DONT_ACCEPT_SAME_RFID_TWICE
	bool "RFID reader doesn't accept the same RFID tag twice in a row"
	default n
	depends on !PAUSE_WHEN_RFID_REMOVED
	help
	  RFID reader doesn't accept the same RFID tag twice in a row (unless
	  it's a modification card or RFID tag is unknown in NVS). See
	  https://forum.espuino.de/t/neues-feature-dont-accept-same-rfid-twice/1247
	  for more information.

config PLAY_LAST_RFID_AFTER_REBOOT
	bool "Enable auto playback of last RFID after reboot"
	default n
	help
	  If enabled and the ESPuino is restarted, the last RFID that was active
	  before, is recalled and played.

config CONTROLS_LOCKED_BY_DEFAULT
	bool "Enables locking of button input when the device starts"
	default n

config SERIAL_LOGLEVEL
	int "Current loglevel for serial console"
	range 1 4
	default 4
	help
	  Use to set the loglevel for the serial debugging console. Use values
	  4 for full debug output, 3 for info level messages, 2 for warning
	  level messages and 1 for error messages only.

config SHUTDOWN_IF_SD_BOOT_FAILS
	bool "Enables shutdown on SD card boot failures"
	default y
	help
	  If enabled the controller will go to deepsleep if boot fails due to
	  SD card errors. This is recommended if there's no other way to restart
	  the controller in battery mode!

config DEEPSLEEP_TIME_AFTER_BOOT_FAILS
	int "Time in seconds after which shutdown is triggered"
	default 20
	depends on SHUTDOWN_IF_SD_BOOT_FAILS

config SHUTDOWN_ON_BAT_CRITICAL
	bool "Enables shutdown if battery level is critical"
	default n
	depends on MEASURE_BATTERY_VOLTAGE || MEASURE_BATTERY_17055

menuconfig STATIC_IP
	bool "Use static IP configuration"
	default n

if STATIC_IP

config LOCAL_IP
	string "ESPuino's static local IP address"
	default "192,168,2,100"
	depends on CONVERT_TO_IDENTIFIER

config GATEWAY_IP
	string "Gateway IP address"
	default "192,168,2,1"
	depends on CONVERT_TO_IDENTIFIER

config SUBNET_MASK
	string "Subnet mask"
	default "255,255,255,0"
	depends on CONVERT_TO_IDENTIFIER

config DNS_IP
	string "DNS Server IP"
	default "192,168,2,1"
	depends on CONVERT_TO_IDENTIFIER

endif # STATIC_IP

config WIFI_DEFAULT_SSID
	string "The deafult SSID (name) of the WiFi AP created by the device"
	default "ESPuino"

config WIFI_DEFAULT_KEY
	string "The deafult key (password) of the WiFi AP created by the device"
	default ""
	help
	  Leave empty to create an unsecured WiFi network without password. If
	  it is non-empty it needs to be at least 8 characters long.

config EXPERT
	bool "Show hidden expert settings"
	default n
	help
	  Only enable this if you know what you do. This will enable additional
	  settings that are normally hidden.

endmenu

menu "ESPuino Audio Settings"

config CACHED_PLAYLIST
	bool "Enables support for playlist caching"
	default y
	help
	  See https://forum.espuino.de/t/neues-feature-cached-playlist/515 for
	  more information.

config HEADPHONE_ADJUST
	bool "Enables adjustment of headphone volume"
	default y
	help
	  If enabled and a headphone is plugged in, an alternative maximum
	  volume is activated to prevent damage to childrens ears.

config MONO_SPEAKER
	bool "Enables mono output for speaker"
	default y
	help
	  If active, mono output is used while headphones remain stereo (if
	  CONFIG_HEADPHONE_ADJUST is active).

config USE_LAST_VOLUME_AFTER_REBOOT
	bool "Enables remembering the volume used before last shutdown"
	default n

config SAVE_PLAYPOS_BEFORE_SHUTDOWN
	bool "Enables saving of the play position on shutdown"
	default n
	help
	  When playback is active and mode audiobook was selected, the last
	  position in the track is saved automatically when shutdown is
	  initiated.

config SAVE_PLAYPOS_WHEN_RFID_CHANGE
	bool "Enables saving of the play position on RFID event"
	default n
	help
	  When playback is active and mode audiobook was selected, the last
	  position in the track is saved automatically when a new RFID tag
	  is detected.

config SEEK_JUMP_OFFSET
	int "Number of seconds to jump forward/backward using CMD_SEEK_*"
	default 30

endmenu

menu "ESPuino Board Selection"

choice
	bool "Board Configuration"
	default BOARD_LOLIN_D32_PRO

config BOARD_AUDIO_KIT
	bool "AI Thinker ESP32-Audio-Kit"

config BOARD_COMPLETE
	bool "ESPuino Complete"

config BOARD_ESP32_S3_DEVKITC
	bool "ESP32-S3 DevKitC"

config BOARD_LOLIN32
	bool "Wemos Lolin32"

config BOARD_LOLIN_D32
	bool "Wemos Lolin D32"

config BOARD_LOLIN_D32_PRO
	bool "Wemos Lolin D32 Pro"

config BOARD_MUSE_PROTO
	bool "RASPIAUDIO ESP32 Muse PROTO"

config BOARD_NODEMCU_32S
	bool "NodeMCU 32S"

config BOARD_NODEMCU_DEVKIT
	bool "AZ Delivery ESP32 NodeMCU/DevKitC"

config BOARD_TTGO_T8
	bool "LilyGo TTGO T8"

config BOARD_WROVER_KIT
	bool "Espressif ESP-WROVER-KIT"

endchoice

menu "Expert Board Settings"
	visible if EXPERT

config GPIO_PA_EN
	int "GPIO for the speaker amp enable signal"
	default 112 if BOARD_COMPLETE
	default 21 if BOARD_AUDIO_KIT
	default 108 if ((BOARD_LOLIN_D32_PRO || BOARD_LOLIN_D32) && !SD_SPI_MODE)
	depends on AMP_SPEAKER

config GPIO_HP_EN
	int "GPIO for the headphone amp enable signal"
	depends on AMP_HEADPHONE

config GPIO_I2S_BCLK
	int "GPIO for the I2S DAC BCLK signal"
	default 5 if BOARD_MUSE_PROTO
	default 27

config GPIO_I2S_DOUT
	int "GPIO for the I2S DAC DOUT signal"
	default 25

config GPIO_I2S_LRC
	int "GPIO for the I2S DAC LRC signal"
	default 26

if ROTARY_ENCODER

config GPIO_ROTENC_CLK
	int "GPIO for the rotary encoder CLK signal"
	default 5 if BOARD_AUDIO_KIT
	default 36 if BOARD_MUSE_PROTO
	default 34

config GPIO_ROTENC_DT
	int "GPIO for the rotary encoder DT signal"
	default 35 if BOARD_NODEMCU_DEVKIT || BOARD_LOLIN32
	default 33 if (BOARD_LOLIN_D32 && SD_SPI_MODE) || BOARD_TTGO_T8
	default 18 if BOARD_AUDIO_KIT
	default 39

endif # ROTARY_ENCODER

if SD_SPI_MODE

config GPIO_SPISD_CS
	int "GPIO for SPI SD Card CS"
	default 4 if BOARD_LOLIN_D32_PRO
	default 15

if !SINGLE_SPI

config GPIO_SPISD_MOSI
	int "GPIO for SPI SD Card MOSI"
	default 23 if BOARD_LOLIN_D32_PRO
	default 13

config GPIO_SPISD_MISO
	int "GPIO for SPI SD Card MISO"
	default 19 if BOARD_LOLIN_D32_PRO
	default 16

config GPIO_SPISD_SCK
	int "GPIO for SPI SD Card SCK"
	default 18 if BOARD_LOLIN_D32_PRO
	default 14

endif # SINGLE_SPI
endif # SD_MMC_1BIT_MODE

if RFID

config GPIO_RFID_RST
	int "GPIO for RFID reader reset signal"
	default 4 if BOARD_MUSE_PROTO
	default 12 if BOARD_AUDIO_KIT
	default 22

if RFID_READER_MFRC522_SPI

config GPIO_RFID_CS
	int "GPIO for RFID reader chip select signal"
	default 21

config GPIO_RFID_SCK
	int "GPIO for RFID reader clock signal"
	default 14 if BOARD_LOLIN_D32_PRO && SD_SPI_MODE
	default 18

config GPIO_RFID_MOSI
	int "GPIO for RFID reader data input signal"
	default 13 if BOARD_LOLIN_D32_PRO && SD_SPI_MODE
	default 23

config GPIO_RFID_MISO
	int "GPIO for RFID reader data output signal"
	default 15 if BOARD_LOLIN_D32_PRO && SD_SPI_MODE
	default 19

endif # RFID_READER_MFRC522_SPI

if RFID_READER_PN5180

config GPIO_RFID_BUSY
	int "GPIO for RFID reader busy signal"
	default 5 if BOARD_TTGO_T8
	default 33 if (BOARD_LOLIN_D32 && !SD_SPI_MODE) || BOARD_LOLIN_D32_PRO || BOARD_COMPLETE
	default 16

config GPIO_RFID_IRQ
	int "GPIO for RFID reader interrupt signal"
	default 13 if BOARD_TTGO_T8
	default 32 if BOARD_COMPLETE
	default 39

endif # RFID_READER_PN5180
endif # RFID

if RFID

config GPIO_RFID_RST
	int "GPIO for RFID reader reset signal"
	default 4 if BOARD_MUSE_PROTO
	default 12 if BOARD_AUDIO_KIT
	default 22

if RFID_READER_MFRC522_SPI

config GPIO_RFID_CS
	int "GPIO for RFID reader chip select signal"
	default 21

config GPIO_RFID_SCK
	int "GPIO for RFID reader clock signal"
	default 14 if BOARD_LOLIN_D32_PRO && SD_SPI_MODE
	default 18

config GPIO_RFID_MOSI
	int "GPIO for RFID reader data input signal"
	default 13 if BOARD_LOLIN_D32_PRO && SD_SPI_MODE
	default 23

config GPIO_RFID_MISO
	int "GPIO for RFID reader data output signal"
	default 15 if BOARD_LOLIN_D32_PRO && SD_SPI_MODE
	default 19

endif # RFID_READER_MFRC522_SPI

if RFID_READER_PN5180

config GPIO_RFID_BUSY
	int "GPIO for RFID reader busy signal"
	default 5 if BOARD_TTGO_T8
	default 33 if (BOARD_LOLIN_D32 && !SD_SPI_MODE) || BOARD_LOLIN_D32_PRO || BOARD_COMPLETE
	default 16

config GPIO_RFID_IRQ
	int "GPIO for RFID reader interrupt signal"
	default 13 if BOARD_TTGO_T8
	default 32 if BOARD_COMPLETE
	default 39

endif # RFID_READER_PN5180
endif # RFID

config GPIO_HALL_SENSOR
	int "GPIO for halleffect sensor"
	default 32 if BOARD_COMPLETE || ((BOARD_LOLIN_D32_PRO || BOARD_LOLIN_D32 || BOARD_LOLIN32) && !SD_SPI_MODE)
	default 34
	depends on HALLEFFECT_SENSOR

config MFRC522_ADDR
	hex "RFID Reader MFRC522 I2C Address"
	default 0x28
	depends on RFID_READER_MFRC522_I2C

config MFRC522_GAIN
	hex "RFID Reader MFRC522 Gain"
	default 0x7
	depends on RFID_READER_MFRC522_I2C || RFID_READER_MFRC522_SPI
	help
	  Sets the gain value for the MFRC522. Use one of the following values:
	  0x2 (18dB), 0x3 (23db), 0x4 (33dB), 0x5 (38dB), 0x6 (43dB), 0x7 (48dB)

config PORT_EXPANDER_ADDR
	hex "PCA9555 Port Expander I2C Address"
	default 0x20
	depends on PORT_EXPANDER

endmenu

menu "Hidden Board Helpers"
	visible if n

config PIO_BOARD
	string "PlatformIO Board configuration"
	default "esp-wrover-kit" if BOARD_AUDIO_KIT || BOARD_COMPLETE || BOARD_MUSE_PROTO || BOARD_TTGO_T8 || BOARD_WROVER_KIT
	default "lolin32" if BOARD_LOLIN32
	default "lolin_d32" if BOARD_LOLIN_D32
	default "lolin_d32_pro" if BOARD_LOLIN_D32_PRO
	default "nodemcu-32s" if BOARD_NODEMCU_32S
	default "az-delivery-devkit-v4" if BOARD_NODEMCU_DEVKIT
	default "esp32-s3-devkitc-1" if BOARD_ESP32_S3_DEVKITC
	depends on EXPORT_TO_PIO

config PIO_EXTENDS
	string "PlatformIO base configurations"
	default "base, extra:esp32, extra:flash16mb_psram" if BOARD_AUDIO_KIT || BOARD_LOLIN_D32_PRO || BOARD_COMPLETE
	default "base, extra:esp32, extra:flash8mb_psram" if BOARD_WROVER_KIT
	default "base, extra:esp32, extra:flash4mb_psram" if BOARD_MUSE_PROTO
	default "base, extra:esp32, extra:flash4mb" if BOARD_LOLIN32 || BOARD_LOLIN_D32 || BOARD_TTGO_T8 || BOARD_NODEMCU_32S || BOARD_NODEMCU_DEVKIT
	default "base, extra:esp32-s3" if BOARD_ESP32_S3_DEVKITC
	default "base"
	depends on EXPORT_TO_PIO

config I2C_2
	bool "Enables support for the second I2C bus"
	default n

endmenu
endmenu

menu "ESPuino Peripheral Settings"

config AMP_SPEAKER
	bool "Enables support for a speaker amp enabled by GPIO"
	default y if BOARD_COMPLETE || BOARD_AUDIO_KIT || ((BOARD_LOLIN_D32_PRO || BOARD_LOLIN_D32) && !SD_SPI_MODE)
	default n

config AMP_HEADPHONE
	bool "Enables support for a headphone amp enabled by GPIO"
	default n

config BLUETOOTH
	bool "Enables Bluetooth support"
	default n if BOARD_ESP32_S3_DEVKITC
	default y
	help
	  If enabled and Bluetooth mode is active, you can stream to your
	  ESPuino via Bluetooth (a2dp-sink).

config BLUETOOTH_SINK_DEVICE_NAME
	string "The name of the Bluetooth device if the ESPuino acts as sink (speaker)"
	default "ESPuino"
	depends on BLUETOOTH

config BLUETOOTH_SOURCE_DEVICE_NAME
	string "The name of the Bluetooth speaker/headset if the ESPuino acts as source"
	default "My POGS Wireless Headphone"
	depends on BLUETOOTH
	help
	  See https://forum.espuino.de/t/neues-feature-bluetooth-kopfhoerer/1293/
	  for more information.

config BUTTON_DEBOUNCE_INTERVAL
	int "Debounce interval for buttons in milliseconds"
	default 50
	range 0 255

config BUTTON_LONGPRESS_INTERVAL
	int "Debounce interval for buttons in milliseconds"
	default 700
	range 0 65535

config HALLEFFECT_SENSOR
	bool "Enables support for hallsensor"
	default n
	help
	  Please note: only user-support provided. See
	  https://forum.espuino.de/t/magnetische-hockey-tags/1449/35 for more
	  information.

config HEADPHONE_DEBOUNCE_INTERVAL
	int "Debounce interval when plugging in headphones in milliseconds"
	default 1000
	depends on HEADPHONE_ADJUST

config I2S_COMM_FMT_LSB
	bool "Enables FMT instead of MSB for I2S-communication-format"
	default n
	help
	  Used e.g. by PT2811. Don't enable for MAX98357a, AC101 or PCM5102A.

config IR_CONTROL
	bool "Enables support for infrared control"
	default n
	help
	  See https://forum.espuino.de/t/neues-feature-fernsteuerung-per-infrarot-fernbedienung/265
	  for more information.

config MEASURE_BATTERY
	bool "Enables support for measuring the battery status"
	default y

if MEASURE_BATTERY

choice
	bool "Battery measurement hardware"
	default MEASURE_BATTERY_VOLTAGE
	depends on MEASURE_BATTERY

config MEASURE_BATTERY_VOLTAGE
	bool "Enables battery measurement via ADC and voltage divider"

config MEASURE_BATTERY_MAX17055
	bool "Enables battery measurement via external fuel gauge (MAX17055)"
	select I2C_2

endchoice

config MEASURE_BATTERY_INTERVAL
	int "Default value for interval of battery check in minutes"
	default 10
	help
	  This parameter can be changed in the GUI.

config MEASURE_BATTERY_LOW
	int "Default value for low/recovery battery status in millivolts"
	default 3400 if MEASURE_BATTERY_VOLTAGE
	default 3600 if MEASURE_BATTERY_MAX17055
	help
	  This parameter can be changed in the GUI (only for ADC). When using
	  the fuel gauge (MAX17055) this reflects the recovery voltage.

config MEASURE_BATTERY_CRIT
	int "Default value for critical/empty battery status in millivolts"
	default 3100 if MEASURE_BATTERY_VOLTAGE
	default 3000 if MEASURE_BATTERY_MAX17055
	help
	  This parameter can be changed in the GUI (only for ADC). When using
	  the fuel gauge (MAX17055) this reflects the empty voltage.

config ADC_BATTERY_INDICATOR_LOW
	int "Default value for the LED battery low indicator (no LED on) in millivolts"
	default 3000
	depends on MEASURE_BATTERY_VOLTAGE
	help
	  This parameter can be changed in the GUI.

config ADC_BATTERY_INDICATOR_HIGH
	int "Default value for the LED battery high indicator (all LEDs on) in millivolts"
	default 4200
	depends on MEASURE_BATTERY_VOLTAGE
	help
	  This parameter can be changed in the GUI.

config FUEL_GAUGE_LOW
	int "Default value for the battery fuel gauge low value in percent"
	range 0 100
	default 15
	depends on MEASURE_BATTERY_MAX17055

config FUEL_GAUGE_CRIT
	int "Default value for the battery fuel gauge critical value in percent"
	range 0 100
	default 5
	depends on MEASURE_BATTERY_MAX17055

config FUEL_GAUGE_CAPACITY
	int "Default value for the battery fuel gauge capacity value in mAh"
	default 6000
	depends on MEASURE_BATTERY_MAX17055

config FUEL_GAUGE_CHEMISTRY
	hex "Default value for the battery fuel gauge cell chemistry"
	default 0x60
	depends on MEASURE_BATTERY_MAX17055
	help
	  Use 0x0 for LiIon, 0x20 for NCR and 0x60 for LiFePO4.

config FUEL_GAUGE_RESISTOR
	int "Default value for the battery fuel gauge current sense resistor value in milliohms"
	default 10
	depends on MEASURE_BATTERY_MAX17055

config FUEL_GAUGE_CHARGE_VOLTAGE_HIGH
	bool "Default value for the battery fuel gauge charge voltage parameter"
	default off
	depends on MEASURE_BATTERY_MAX17055
	help
	  Enable this if the charge voltage exceeds 4.275V.

endif # MEASURE_BATTERY

menuconfig NEOPIXEL
	bool "Enable support for NeoPixel LEDs"
	default y

if NEOPIXEL

config NEOPIXEL_CENTER_PAUSE
	bool "Center pause LED pattern"
	default n
	help
	  If true the pause pattern is centered in the middle of the strip.

config NEOPIXEL_CHIPSET
	string "Type of NeoPixels"
	default WS2812B
	depends on CONVERT_TO_IDENTIFIER

config NEOPIXEL_COLOR_ORDER
	string "Order of NeoPixel colors"
	default GRB
	depends on CONVERT_TO_IDENTIFIER

config NEOPIXEL_DIMMABLE_STATES
	int "Number of intermediate values between to LEDs with full brightness"
	default 50
	help
	  See https://forum.espuino.de/t/led-verbesserungen-rework/1739 for more
	  information.

config NEOPIXEL_NUM_IDLE_DOTS
	int "Number of LED dots which are on when idle"
	default 4

config NEOPIXEL_NUM_LEDS
	int "Number of NeoPixel LEDs available"
	default 24

config NEOPIXEL_OFFSET
	int "Offset for first LED"
	range 0 NEOPIXEL_NUM_LEDS
	default 0
	help
	  Shifts the starting LED in the original direction of the NeoPixel ring.

config NEOPIXEL_PROGRESS_HUE_START
	int "Start hue for LED progress indicator"
	default 85
	help
	  Hue ranges from basically 0 - 255, but you can also set numbers
	  outside this range to get the desired effect (e.g. 85 - 215 will go
	  from green to purple via blue, 341 - 215 start and end at exactly the
	  same color but go from green to purple via yellow and red).

config NEOPIXEL_PROGRESS_HUE_END
	int "End hue for LED progress indicator"
	default -1
	help
	  Hue ranges from basically 0 - 255, but you can also set numbers
	  outside this range to get the desired effect (e.g. 85 - 215 will go
	  from green to purple via blue, 341 - 215 start and end at exactly the
	  same color but go from green to purple via yellow and red).

config NEOPIXEL_REVERSE
	bool "Reverse direction of NeoPixel LEDs"
	default n

endif # NEOPIXEL

config PORT_EXPANDER
	bool "Enables support for the PCA9555 port expander"
	default n
	select I2C_2
	help
	  See https://forum.espuino.de/t/einsatz-des-port-expanders-pca9555/306
	  for more information."

menuconfig RFID
	bool "Enables support for RFID reader"
	default y

if RFID

choice
	bool "Select RFID reader type"
	default RFID_READER_MFRC522_SPI

config RFID_READER_MFRC522_SPI
	bool "MFRC522 connected via SPI"

config RFID_READER_MFRC522_I2C
	bool "MFRC522 connected via I2C"
	select I2C_2

config RFID_READER_PN5180
	bool "PN5180 connected via I2C"

endchoice

config RFID_SCAN_INTERVAL
	int "Scan interval for MFRC522 driver in milliseconds"
	default 100
	depends on RFID_READER_MFRC522_SPI || RFID_READER_MFRC522_I2C

config RFID_LPCD
	bool "Enables support for wakeup triggered by RFID tag"
	default n
	depends on RFID_READER_PN5180
	help
	  Wakes up ESPuino if RFID tag was applied while deepsleep is active.
	  Only ISO-14443-tags are supported for wakeup!

endif # RFID

menuconfig ROTARY_ENCODER
	bool "Enables support for rotary encoder"
	default y

if ROTARY_ENCODER

config INCLUDE_ROTARY_IN_CONTROLS_LOCK
	bool "If set the rotary encoder is locked if controls are locked"
	default y

endif # ROTARY_ENCODER

choice
	bool "Select SD card interface mode"
	default SD_MMC_1BIT_MODE

config SD_MMC_1BIT_MODE
	bool "MMC interface with 1 bit buswidth"

config SD_SPI_MODE
	bool "SPI interface"

endchoice

config SINGLE_SPI
	bool "Use single SPI instance instead of two (not yet working!)"
	default n

endmenu

menu "ESPuino Button Configuration"

config BUTTON_0_SHORT
	string "Button 0 short press command"
	default "CMD_NEXTTRACK"
	depends on CONVERT_TO_IDENTIFIER

config BUTTON_1_SHORT
	string "Button 1 short press command"
	default "CMD_PREVTRACK"
	depends on CONVERT_TO_IDENTIFIER

config BUTTON_2_SHORT
	string "Button 2 short press command"
	default "CMD_PLAYPAUSE"
	depends on CONVERT_TO_IDENTIFIER

config BUTTON_3_SHORT
	string "Button 3 short press command"
	default "CMD_MEASUREBATTERY"
	depends on CONVERT_TO_IDENTIFIER

config BUTTON_4_SHORT
	string "Button 4 short press command"
	default "CMD_SEEK_BACKWARDS"
	depends on CONVERT_TO_IDENTIFIER

config BUTTON_5_SHORT
	string "Button 5 short press command"
	default "CMD_SEEK_FORWARDS"
	depends on CONVERT_TO_IDENTIFIER

config BUTTON_0_LONG
	string "Button 0 long press command"
	default "CMD_LASTTRACK"
	depends on CONVERT_TO_IDENTIFIER

config BUTTON_1_LONG
	string "Button 1 long press command"
	default "CMD_FIRSTTRACK"
	depends on CONVERT_TO_IDENTIFIER

config BUTTON_2_LONG
	string "Button 2 long press command"
	default "CMD_PLAYPAUSE"
	depends on CONVERT_TO_IDENTIFIER

config BUTTON_3_LONG
	string "Button 3 long press command"
	default "CMD_SLEEPMODE"
	depends on CONVERT_TO_IDENTIFIER

config BUTTON_4_LONG
	string "Button 4 long press command"
	default "CMD_VOLUMEUP"
	depends on CONVERT_TO_IDENTIFIER

config BUTTON_5_LONG
	string "Button 5 long press command"
	default "CMD_VOLUMEDOWN"
	depends on CONVERT_TO_IDENTIFIER

config BUTTON_MULTI_01
	string "Combined button 0 and 1 press"
	default "CMD_NOTHING"
	depends on CONVERT_TO_IDENTIFIER

config BUTTON_MULTI_02
	string "Combined button 0 and 2 press"
	default "CMD_ENABLE_FTP_SERVER"
	depends on CONVERT_TO_IDENTIFIER

config BUTTON_MULTI_03
	string "Combined button 0 and 3 press"
	default "CMD_NOTHING"
	depends on CONVERT_TO_IDENTIFIER

config BUTTON_MULTI_04
	string "Combined button 0 and 4 press"
	default "CMD_NOTHING"
	depends on CONVERT_TO_IDENTIFIER

config BUTTON_MULTI_05
	string "Combined button 0 and 5 press"
	default "CMD_NOTHING"
	depends on CONVERT_TO_IDENTIFIER

config BUTTON_MULTI_12
	string "Combined button 1 and 2 press"
	default "CMD_TELL_IP_ADDRESS"
	depends on CONVERT_TO_IDENTIFIER

config BUTTON_MULTI_13
	string "Combined button 1 and 3 press"
	default "CMD_NOTHING"
	depends on CONVERT_TO_IDENTIFIER

config BUTTON_MULTI_14
	string "Combined button 1 and 4 press"
	default "CMD_NOTHING"
	depends on CONVERT_TO_IDENTIFIER

config BUTTON_MULTI_15
	string "Combined button 1 and 5 press"
	default "CMD_NOTHING"
	depends on CONVERT_TO_IDENTIFIER

config BUTTON_MULTI_23
	string "Combined button 2 and 3 press"
	default "CMD_NOTHING"
	depends on CONVERT_TO_IDENTIFIER

config BUTTON_MULTI_24
	string "Combined button 2 and 4 press"
	default "CMD_NOTHING"
	depends on CONVERT_TO_IDENTIFIER

config BUTTON_MULTI_25
	string "Combined button 2 and 5 press"
	default "CMD_NOTHING"
	depends on CONVERT_TO_IDENTIFIER

config BUTTON_MULTI_34
	string "Combined button 3 and 4 press"
	default "CMD_NOTHING"
	depends on CONVERT_TO_IDENTIFIER

config BUTTON_MULTI_35
	string "Combined button 3 and 5 press"
	default "CMD_NOTHING"
	depends on CONVERT_TO_IDENTIFIER

config BUTTON_MULTI_45
	string "Combined button 4 and 5 press"
	default "CMD_NOTHING"
	depends on CONVERT_TO_IDENTIFIER

endmenu
```
